## meta-octagon/conf/machine/sfx6008.conf
```bitbake
#@TYPE: Machine
#@NAME: sfx6008
#@DESCRIPTION: Machine configuration for the sfx6008

SOC_FAMILY = "hisi3716mv430"
CHIPSET = "Hi3716Mv430"
HICHIPSET = "3716mv430"

BRAND_OEM = "octagon"
MACHINE_BRAND = "Octagon"
MACHINE_NAME = "SFX6008 IP"

MTD_KERNEL = "mtd10"
MTD_ROOTFS = "mtd12"
KERNEL_FILE = "kernel.bin"
ROOTFS_FILE = "rootfs.ubi"

MACHINE_FEATURES += " textlcd 7segment blindscan-dvbs no-opengl wol hisil mali emmc skins1080 no-subssupport fastboot HDMI HDMISTANDBY AV_JACK"
OPENPLI_FEATURES += " qtplugins"
DISTRO_FEATURES:remove = "x11 wayland directfb"

EXTRA_OECONF:append:pn-enigma2 = "--with-lcddev=/dev/null --with-alphablendingacceleration=always --with-blitaccelerationthreshold=250  --with-fillaccelerationthreshold=190000"

require conf/machine/include/octagon-hisi-3716mv430.inc

MACHINE_ESSENTIAL_EXTRA_RDEPENDS += "\
    firmware-rtl8188fu \
    kernel-module-8188fu \
    "
```
