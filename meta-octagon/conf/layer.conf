## meta-octagon/conf/layer.conf
```bitbake
# We have a conf and classes directory, append to BBPATH
BBPATH .= ":${LAYERDIR}"

BBFILES += "${LAYERDIR}/recipes-*/*.bb ${LAYERDIR}/recipes-*/*/*.bb \
            ${LAYERDIR}/recipes-*/*.bbappend ${LAYERDIR}/recipes-*/*/*.bbappend"

BSP-BASE-OCTAGON := '${@os.path.normpath("${LAYERDIR}/")}'
BBFILE_COLLECTIONS += "octagon-layer"
BBFILE_PATTERN_octagon-layer := "^${LAYERDIR}/"
BBFILE_PRIORITY_octagon-layer = "7"
LAYERSERIES_COMPAT_octagon-layer = "blacksail"
```
